## configs/s5p6818_nanopi3_defconfig
```kconfig
CONFIG_ARM=y
CONFIG_ARCH_NEXELL=y
CONFIG_ARCH_S5P6818=y
CONFIG_TARGET_NANOPI3=y
CONFIG_DM_I2C=y
CONFIG_DM_GPIO=y
CONFIG_DEFAULT_DEVICE_TREE="s5p6818-nanopi3"
CONFIG_FIT=y
# CONFIG_CMD_IMI is not set
# CONFIG_CMD_IMLS is not set
# CONFIG_CMD_FLASH is not set
CONFIG_CMD_I2C=y
CONFIG_CMD_USB=y
# CONFIG_CMD_FPGA is not set
CONFIG_CMD_GPIO=y
# CONFIG_CMD_SETEXPR is not set

# CONFIG_CMD_NFS is not set
CONFIG_CMD_FDISK=y
CONFIG_CMD_EXT4_IMG_WRITE=y
CONFIG_CMD_SD_RECOVERY=y
CONFIG_CMD_PMIC=y
CONFIG_CMD_REGULATOR=y
CONFIG_OF_CONTROL=y
CONFIG_OF_EMBED=y
CONFIG_DM=y
CONFIG_NX_GPIO=y
CONFIG_DM_I2C_GPIO=y
CONFIG_SYS_I2C_NEXELL=y
CONFIG_DM_PMIC=y
CONFIG_DM_PMIC_AXP228=y
CONFIG_DM_REGULATOR=y
CONFIG_DM_REGULATOR_AXP228=y
CONFIG_DM_PWM=y
CONFIG_USB=y
CONFIG_DM_USB=y
CONFIG_USB_EHCI_HCD=y
CONFIG_USB_STORAGE=y
CONFIG_DISPLAY_PORT=y
CONFIG_VIDEO_NX=y
CONFIG_VIDEO_NX_RGB=y
CONFIG_VIDEO_NX_LVDS=y
CONFIG_VIDEO_NX_HDMI=y
CONFIG_REGEX=y
CONFIG_ERRNO_STR=y

CONFIG_CMD_NET=y
CONFIG_CMD_TFTPPUT=y
CONFIG_CMD_TFTPSRV=y
CONFIG_CMD_PING=y

CONFIG_NET=y
# CONFIG_NET_RANDOM_ETHADDR is not set
# CONFIG_NETCONSOLE is not set
CONFIG_NET_TFTP_VARS=y
CONFIG_DM_ETH=y
CONFIG_PHYLIB=y
CONFIG_PHY_REALTEK=y
CONFIG_NETDEVICES=y
# CONFIG_ALTERA_TSE is not set
# CONFIG_E1000 is not set
CONFIG_ETH_DESIGNWARE=y
CONFIG_PINCTRL=y
CONFIG_PINCTRL_FULL=y
CONFIG_PINCTRL_GENERIC=y
CONFIG_PINMUX=y
# CONFIG_PINCONF is not set
# CONFIG_ROCKCHIP_PINCTRL is not set
# CONFIG_ROCKCHIP_3036_PINCTRL is not set
CONFIG_PINCTRL_NEXELL=y
CONFIG_PINCTRL_NEXELL_S5PXX18=y
# CONFIG_PINCTRL_NEXELL_NXP5540 is not set
```

## drivers/net/phy/Kconfig
```kconfig
config PHY_REALTEK
    depends on PHYLIB
    bool "RealTek RTL8211 Ethernet PHYs support"
    default y if PHYLIB
```
